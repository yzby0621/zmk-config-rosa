## config/boards/shields/h65/Kconfig.defconfig
```kconfig
# Copyright (c) 2020 The ZMK Contributors
# SPDX-License-Identifier: MIT

if SHIELD_H65

config ZMK_KEYBOARD_NAME
	default "h65"

endif
```

## config/boards/shields/h65/Kconfig.shield
```kconfig
# Copyright (c) 2020 The ZMK Contributors
# SPDX-License-Identifier: MIT

config SHIELD_H65
	def_bool $(shields_list_contains,h65)
```

## config/west.yml
```yaml
manifest:
  remotes:
    - name: pierrechevalier83
      url-base: https://github.com/pierrechevalier83
  projects:
    - name: zmk
      remote: pierrechevalier83
      revision: rosa
      import: app/west.yml
  self:
    path: config
```
